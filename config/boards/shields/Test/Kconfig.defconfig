## config/boards/shields/Test/Kconfig.defconfig
```kconfig
if SHIELD_ROBA_DONGLE

config ZMK_KEYBOARD_NAME
    default "cool642tb-mini"

config ZMK_SPLIT
    default y

config ZMK_SPLIT_ROLE_CENTRAL
    default y

config ZMK_SPLIT_BLE_CENTRAL_PERIPHERALS
    default 2

endif

if SHIELD_ROBA_R

config ZMK_SPLIT
    default y

endif

if SHIELD_ROBA_L

config ZMK_SPLIT
    default y

endif
```

## config/west.yml
```yaml
manifest:
  remotes:
    - name: zmkfirmware
      url-base: https://github.com/zmkfirmware
    - name: t-ogura
      url-base: https://github.com/t-ogura
    - name: cormoran
      url-base: https://github.com/cormoran

  projects:
    - name: zmk
      remote: cormoran
      revision: main+dya
      import: app/west.yml
    - name: prospector-zmk-module
      remote: t-ogura
      revision: v2.2b

    # DYA Studio modules
    - name: zmk-module-battery-history
      remote: cormoran
      revision: main
    - name: zmk-module-settings-rpc
      remote: cormoran
      revision: main
    - name: zmk-behavior-runtime-sensor-rotate
      remote: cormoran
      revision: main

  self:
    path: config
```
